## components/voip/Kconfig.projbuild
```kconfig
menu "VOIP/PING Configuration"

    config PING_TARGET_ADDR
        string "Ping target IP address"
        default "127.0.0.1"
        help
            Destination IP address for ping

    config VOIP_HOSTNAME
        string "VOIP hostname"
        default "chicago1.voip.ms"
        help
            Hostname (server) used for VOIP account

    config VOIP_USERNAME
        string "VOIP username"
        help
            VOIP account username

    config VOIP_PASSWORD
        string "VOIP password"
        help
            VOIP account password

    config VOIP_CALL_NUMBER
        string "Number to call"
        help
            This number will be called when the program runs

endmenu
```

## phone32/components/voip/Kconfig.projbuild
```kconfig
menu "VOIP/PING Configuration"

    config PING_TARGET_ADDR
        string "Ping target IP address"
        default "127.0.0.1"
        help
            Destination IP address for ping

    choice ESP_WIFI_AUTH_TYPE
        prompt "WiFi authentication type"
        default ESP_AUTH_WPA3
        help
            WiFi authentication type (wpa3 or wpa2-enterprise)
            -- determines if using ssid/pass or ssid/id/user/pass

        config ESP_AUTH_WPA3
            bool "WPA3"
        config ESP_AUTH_WPA2_ENTERPRISE
            bool "WPA2_ENTERPRISE"
    endchoice

    config ESP_WIFI_SSID
        string "WiFi SSID"
        default "myssid"
        help
            SSID (network name) for the example to connect to.

    config ESP_WIFI_USERNAME
        string "WiFi Username"
        default "myusername"
        help
            WiFi username (WPA2-enterprise) to use

    config ESP_WIFI_EAP_ID
        string "WiFi EAP ID"
        default "anonymous_esp32"
        help
            ID sent to the router for WPA2-enterprise (use default)

    config ESP_WIFI_PASSWORD
        string "WiFi Password"
        default "mypassword"
        help
            WiFi password (WPA or WPA2) for the example to use.

    choice ESP_WIFI_SAE_MODE
        prompt "WPA3 SAE mode selection"
        default ESP_WPA3_SAE_PWE_BOTH
        help
            Select mode for SAE as Hunt and Peck, H2E or both.
        config ESP_WPA3_SAE_PWE_HUNT_AND_PECK
            bool "HUNT AND PECK"
        config ESP_WPA3_SAE_PWE_HASH_TO_ELEMENT
            bool "H2E"
        config ESP_WPA3_SAE_PWE_BOTH
            bool "BOTH"
    endchoice

    config ESP_WIFI_PW_ID
        string "PASSWORD IDENTIFIER"
        depends on  ESP_WPA3_SAE_PWE_HASH_TO_ELEMENT|| ESP_WPA3_SAE_PWE_BOTH
        default ""
        help
            password identifier for SAE H2E

    config ESP_MAXIMUM_RETRY
        int "Maximum retry"
        default 5
        help
            Set the Maximum retry to avoid station reconnecting to the AP unlimited when the AP is really inexistent.

    choice ESP_WIFI_SCAN_AUTH_MODE_THRESHOLD
        prompt "WiFi Scan auth mode threshold"
        default ESP_WIFI_AUTH_WPA2_PSK
        help
            The weakest authmode to accept in the scan mode.
            This value defaults to ESP_WIFI_AUTH_WPA2_PSK incase password is present and ESP_WIFI_AUTH_OPEN is used.
            Please select ESP_WIFI_AUTH_WEP/ESP_WIFI_AUTH_WPA_PSK incase AP is operating in WEP/WPA mode.

        config ESP_WIFI_AUTH_OPEN
            bool "OPEN"
        config ESP_WIFI_AUTH_WEP
            bool "WEP"
        config ESP_WIFI_AUTH_WPA_PSK
            bool "WPA PSK"
        config ESP_WIFI_AUTH_WPA2_PSK
            bool "WPA2 PSK"
        config ESP_WIFI_AUTH_WPA_WPA2_PSK
            bool "WPA/WPA2 PSK"
        config ESP_WIFI_AUTH_WPA3_PSK
            bool "WPA3 PSK"
        config ESP_WIFI_AUTH_WPA2_WPA3_PSK
            bool "WPA2/WPA3 PSK"
        config ESP_WIFI_AUTH_WAPI_PSK
            bool "WAPI PSK"
    endchoice

endmenu
```
